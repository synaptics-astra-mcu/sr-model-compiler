## tests/models/uc_person_classification/kconfig
```kconfig
config UC_PERSON_CLASSIFICATION_ENABLED
    bool "UC_PERSON_CLASSIFICATION_ENABLED"
    select MODULE_NPU_ENABLED
    help
        This config enables the Person classification usecase. The UC_PERSON_CLASSIFICATION sample application is used for binary classification of objects in the camera's field of view. This application identifies whether the object in view is a person or not a person, and classifies it accordingly into one of the two predefined classes.
```

## tests/models/uc_person_detection/kconfig
```kconfig
config UC_PERSON_DETECTION_ENABLED
    bool "UC_PERSON_DETECTION_ENABLED"
    select MODULE_NPU_ENABLED
    help
        This config enables the Detection usecase. The UC_PERSON_DETECTION sample application is used for real-time object detection within the camera's field of view. This application identifies whether a person is present in the frame and provides the bounding box coordinates for each detected individual. Along with the coordinates, it also outputs a confidence score indicating the likelihood that the detected object is a person. The application supports detection of multiple persons simultaneously within a single frame.
```

## tests/models/uc_person_pose_detection/kconfig
```kconfig
config UC_PERSON_POSE_DETECTION_ENABLED
    bool "UC_PERSON_POSE_DETECTION_ENABLED"
    select MODULE_NPU_ENABLED
    help
        This config enables the Person Pose Detection usecase. The UC_PERSON_POSE_DETECTION sample application is used for real-time human pose estimation within the camera's field of view. This application detects persons in the frame and provides keypoints corresponding to major joints of the human body. For each detected individual, it outputs 17 keypoints that represent anatomical landmarks such as the head, shoulders, elbows, wrists, hips, knees, and ankles. These keypoints can be connected to form a skeletal representation, effectively capturing the pose of the person. In addition to the keypoints, the application also provides the bounding box coordinates for each detected person. The application supports pose detection for multiple persons simultaneously within a single frame.
```

## tests/models/uc_person_segmentation/kconfig
```kconfig
config UC_PERSON_SEGMENTATION_ENABLED
    bool "UC_PERSON_SEGMENTATION_ENABLED"
    select MODULE_NPU_ENABLED
    help
        This config enables the Segmentation usecase. The UC_PERSON_SEGMENTATION sample application is used for real-time semantic segmentation of persons within the camera's field of view. This application identifies whether a person is present in the frame and provides a pixel-level segmentation mask for each detected individual. In addition to the segmentation mask, it also outputs the bounding box coordinates for each segmented person. The application supports segmentation of multiple persons simultaneously within a single frame, enabling detailed spatial understanding of each individual in the scene.
```
